/*
 * Copyright (c) 2017 Linaro Limited
 *
 * SPDX-License-Identifier: Apache-2.0
 */

/dts-v1/;
#include <renesas/ra/r7fa2l1ab3cfp.dtsi>

/ {
	model = "Renesas EK-RA2L1 development board";
	compatible = "ra,ek-ra2l1";

	chosen {
		zephyr,sram = &sram0;
		zephyr,flash = &flash0;
	};

};
