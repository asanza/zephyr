## boards/renesas/ek-ra2l1/Kconfig.ek-ra2l1
```kconfig
# Copyright (c) 2024 Diego Asanza
# SPDX-License-Identifier: Apache-2.0

config BOARD_EK_RA2L1
	select SOC_R7FA2L1AB3CFP
```

## soc/renesas/ra/ra2l1/Kconfig
```kconfig
# Copyright (c) 2023 TOKITA Hiroshi <tokita.hiroshi@fujitsu.com>
# SPDX-License-Identifier: Apache-2.0

config SOC_SERIES_RA2L1
	select ARM
	select CPU_CORTEX_M23
	select CPU_CORTEX_M_HAS_SYSTICK
	select DYNAMIC_INTERRUPTS
	select TIMER_READS_ITS_FREQUENCY_AT_RUNTIME
	select XIP

config SOC_OPTION_SETTING_MEMORY
	bool "Option Setting Memory"
	default y
```

## soc/renesas/ra/ra2l1/Kconfig.defconfig
```kconfig
# Copyright (c) 2023 TOKITA Hiroshi <tokita.hiroshi@fujitsu.com>
# SPDX-License-Identifier: Apache-2.0

if SOC_SERIES_RA2L1

config SYS_CLOCK_HW_CYCLES_PER_SEC
	default 12000000

config NUM_IRQS
	default 32

endif # SOC_SERIES_RA2L1
```

## soc/renesas/ra/ra2l1/Kconfig.soc
```kconfig
# Copyright (c) 2023 TOKITA Hiroshi <tokita.hiroshi@fujitsu.com>
# SPDX-License-Identifier: Apache-2.0

config SOC_SERIES_RA2L1
	bool
	select SOC_FAMILY_RENESAS_RA
	help
	  Renesas RA2L1

config SOC_R7FA2L1AB3CFP
	bool
	select SOC_SERIES_RA2L1
	help
	  R7FA2L1AB3CFP

config SOC_SERIES
	default "ra2l1" if SOC_SERIES_RA2L1

config SOC
	default "r7fa2l1ab3cfp" if SOC_R7FA2L1AB3CFP
```
